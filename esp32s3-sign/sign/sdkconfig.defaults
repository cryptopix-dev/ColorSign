## esp32s3-sign/sign/sdkconfig.defaults
```kconfig
# ESP32-S3 ColorSign Test Project Configuration

# Target
CONFIG_IDF_TARGET="esp32s3"

# CPU frequency
CONFIG_ESP32S3_DEFAULT_CPU_FREQ_MHZ=240

# Enable C++ support
CONFIG_COMPILER_CXX_EXCEPTIONS=y
CONFIG_CXX_RTTI=y
CONFIG_COMPILER_CXX_STANDARD=14

# FreeRTOS
CONFIG_FREERTOS_HZ=1000

# Logging
CONFIG_LOG_DEFAULT_LEVEL_INFO=y
CONFIG_LOG_MAXIMUM_LEVEL_INFO=y

# Disable unused features to save memory
CONFIG_ESP32S3_DATA_CACHE_SIZE=32
CONFIG_ESP32S3_INSTRUCTION_CACHE_SIZE=32
```
